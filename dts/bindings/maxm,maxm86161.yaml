## dts/bindings/maxm,maxm86161.yaml
```yaml
description: MAXM86161 I2C Device

compatible: "maxim,maxm86161"

include: [sensor-device.yaml, i2c-device.yaml]
```

## sensor/maxm86161/Kconfig
```kconfig
# Configuration options

config MAXM86161
	bool "MAXM86161 Driver"
	default n
	select I2C
	help
	  Enable the driver for the Maxim MAXM86161 PPG Sensor
```
